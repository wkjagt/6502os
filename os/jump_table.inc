.global __JUMPTABLE_START__

.global JMP_DUMP
.global JMP_RCV
.global JMP_INIT_SCREEN
.global JMP_RUN
.global JMP_RESET
.global JMP_PUTC
.global JMP_PRINT_HEX
.global JMP_XMODEM_RCV
.global JMP_GETC
.global JMP_INIT_KB
.global JMP_LINE_INPUT
.global JMP_IRQ_HANDLER
.global JMP_NMI_HANDLER
.global JMP_INIT_SERIAL
.global JMP_CURSOR_ON
.global JMP_CURSOR_OFF
.global JMP_DRAW_PIXEL
.global JMP_RMV_PIXEL
.global JMP_INIT_STORAGE
.global JMP_STOR_READ
.global JMP_STOR_WRITE
.global JMP_STOR_READ_PAGE
.global JMP_STOR_WRITE_PAGE
.global JMP_GET_INPUT
.global JMP_CLR_INPUT
.global JMP_LOAD_FAT
.global JMP_CLEAR_FAT
.global JMP_FIND_EMPTY_PAGE
.global JMP_CLEAR_DIR
.global JMP_LOAD_DIR
.global JMP_SAVE_DIR
.global JMP_SHOW_DIR
.global JMP_FORMAT_DIVE
.global JMP_PRINT_STRING
.global JMP_ADD_TO_DIR
.global JMP_FIND_EMPTY_DIR
.global JMP_FIND_FILE
.global JMP_INIT_GRAPHIC_SCREEN
.global JMP_SPRITE_PATTERNS_WRT
.global JMP_PATTERNS_WRITE
.global JMP_COLORS_WRITE