.import __VIA1_START__

VIA1_REGISTER_PORTB = $00
VIA1_REGISTER_PORTA = $01
VIA1_REGISTER_DDRB  = $02
VIA1_REGISTER_DDRA  = $03
VIA1_REGISTER_T1CL  = $04
VIA1_REGISTER_T1CH  = $05
VIA1_REGISTER_T1LL  = $06
VIA1_REGISTER_T1LH  = $07
VIA1_REGISTER_T2CL  = $08
VIA1_REGISTER_T2CH  = $09
VIA1_REGISTER_SR    = $0a
VIA1_REGISTER_ACR   = $0b
VIA1_REGISTER_PCR   = $0c
VIA1_REGISTER_IFR   = $0d
VIA1_REGISTER_IER   = $0e
VIA1_REGISTER_PANH  = $0f

VIA1_PORTB = __VIA1_START__ + VIA1_REGISTER_PORTB
VIA1_PORTA = __VIA1_START__ + VIA1_REGISTER_PORTA
VIA1_DDRB  = __VIA1_START__ + VIA1_REGISTER_DDRB
VIA1_DDRA  = __VIA1_START__ + VIA1_REGISTER_DDRA
VIA1_T1CL  = __VIA1_START__ + VIA1_REGISTER_T1CL
VIA1_T1CH  = __VIA1_START__ + VIA1_REGISTER_T1CH
VIA1_T1LL  = __VIA1_START__ + VIA1_REGISTER_T1LL
VIA1_T1LH  = __VIA1_START__ + VIA1_REGISTER_T1LH
VIA1_T2CL  = __VIA1_START__ + VIA1_REGISTER_T2CL
VIA1_T2CH  = __VIA1_START__ + VIA1_REGISTER_T2CH
VIA1_SR    = __VIA1_START__ + VIA1_REGISTER_SR
VIA1_ACR   = __VIA1_START__ + VIA1_REGISTER_ACR
VIA1_PCR   = __VIA1_START__ + VIA1_REGISTER_PCR
VIA1_IFR   = __VIA1_START__ + VIA1_REGISTER_IFR
VIA1_IER   = __VIA1_START__ + VIA1_REGISTER_IER
VIA1_PANH  = __VIA1_START__ + VIA1_REGISTER_PANH
